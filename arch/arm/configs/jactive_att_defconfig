## arch/arm/configs/jactive_att_defconfig
```kconfig
CONFIG_MACH_JACTIVE_ATT=y
CONFIG_EXTRA_FIRMWARE="audience-es325-fw-jactive_att.bin"
CONFIG_EXTRA_FIRMWARE_DIR="firmware"
CONFIG_AUTHENTEC_VPNCLIENT_INTERCEPTOR=m
CONFIG_FB_MSM_MIPI_RENESAS_TFT_VIDEO_FULL_HD_PT_PANEL=y
CONFIG_SUPPORT_DISPLAY_OCTA_TFT=y
CONFIG_S5K3H5XA=y
CONFIG_S5K6B2YX=y
# CONFIG_FB_MSM_MIPI_SAMSUNG_OCTA_VIDEO_FULL_HD_PT_PANEL is not set
# CONFIG_LCD_VDD3_BY_PMGPIO is not set
```

## arch/arm/configs/jf_att_defconfig
```kconfig
CONFIG_MACH_JF_ATT=y
CONFIG_EXTRA_FIRMWARE="audience-es325-fw.bin"
CONFIG_EXTRA_FIRMWARE_DIR="firmware"
CONFIG_IRDA_MC96=y
# InsideSecure VPN Client
CONFIG_INSIDESECURE_VPNCLIENT=y
```

## arch/arm/configs/jf_can_defconfig
```kconfig
CONFIG_MACH_JF_ATT=y
CONFIG_MACH_JF_CAN=y
CONFIG_EXTRA_FIRMWARE="audience-es325-fw-tmo.bin"
CONFIG_EXTRA_FIRMWARE_DIR="firmware"
CONFIG_IRDA_MC96=y
```

## arch/arm/configs/jf_cmcccsfb_defconfig
```kconfig
CONFIG_MACH_JF_EUR=y
CONFIG_EXTRA_FIRMWARE="audience-es325-fw-cmcc.bin"
CONFIG_EXTRA_FIRMWARE_DIR="firmware"
CONFIG_RTC_AUTO_PWRON=y
CONFIG_RTC_AUTO_PWRON_PARAM=y
CONFIG_TARGET_LOCALE_CHN=y
CONFIG_WLAN_REGION_CODE=300
CONFIG_MACH_JF_CMCC=y
CONFIG_MACH_JF_CMCCCSFB=y
```

## arch/arm/configs/jf_cri_defconfig
```kconfig
CONFIG_MACH_JF_CRI=y
CONFIG_EXTRA_FIRMWARE="audience-es325-fw.bin"
CONFIG_EXTRA_FIRMWARE_DIR="firmware"
```

## arch/arm/configs/jf_dcm_defconfig
```kconfig
CONFIG_MACH_JF_DCM=y
CONFIG_TARGET_LOCALE_JPN=y
CONFIG_EXTRA_FIRMWARE="audience-es325-fw.bin"
CONFIG_EXTRA_FIRMWARE_DIR="firmware"
CONFIG_IRDA_MC96=y
CONFIG_AUTHENTEC_VPNCLIENT_INTERCEPTOR=m

CONFIG_CAMERA_SW_I2C=y
CONFIG_CAMERA_USE_GSBI7=y

CONFIG_ISDBTMM=y
CONFIG_FELICA=y
CONFIG_NFC_FELICA=y
CONFIG_BCM2079X_NFC_I2C=n
CONFIG_MMC_CPRM=y
CONFIG_TMM_ANT_DET=y
CONFIG_TMM_CHG_CTRL=y

CONFIG_WLAN_REGION_CODE=400

#TmmSecure start
CONFIG_SECURITY_PATH=y
CONFIG_SECURITYFS=y
CONFIG_SECURITY_SEC=y
#TmmSecure end
```

## arch/arm/configs/jf_ktt_defconfig
```kconfig
CONFIG_TARGET_LOCALE_KOR=y
CONFIG_MACH_JF_KTT=y
CONFIG_EXTRA_FIRMWARE="audience-es325-fw-kor.bin"
CONFIG_EXTRA_FIRMWARE_DIR="firmware"
CONFIG_IRDA_MC96=y
CONFIG_TDMB=y
CONFIG_TDMB_SPI=y
CONFIG_TDMB_VENDOR_FCI=y
CONFIG_TDMB_FC8050=y
CONFIG_TDMB_ANT_DET=y
CONFIG_WLAN_REGION_CODE=202
CONFIG_CAMERA_SW_I2C=y
CONFIG_CAMERA_USE_GSBI7=y
```

## arch/arm/configs/jf_lgt_defconfig
```kconfig
CONFIG_TARGET_LOCALE_KOR=y
CONFIG_MACH_JF_LGT=y
CONFIG_EXTRA_FIRMWARE="audience-es325-fw-kor.bin"
CONFIG_EXTRA_FIRMWARE_DIR="firmware"

CONFIG_TDMB=y
CONFIG_TDMB_VENDOR_TELECHIPS=y
CONFIG_TDMB_TCC3170=y
CONFIG_TDMB_SPI=y
CONFIG_TDMB_ANT_DET=y
CONFIG_WLAN_REGION_CODE=203
CONFIG_LGUIWLAN=y
CONFIG_CAMERA_SW_I2C=y
CONFIG_CAMERA_USE_GSBI7=y
```

## arch/arm/configs/jf_rfr_defconfig
```kconfig
CONFIG_MACH_JF_SPR=y
CONFIG_BOARD_JF_REFRESH=y
CONFIG_EXTRA_FIRMWARE="audience-es325-fw.bin"
CONFIG_EXTRA_FIRMWARE_DIR="firmware"
CONFIG_INSIDESECURE_VPNCLIENT=y
```

## arch/arm/configs/jf_skt_defconfig
```kconfig
CONFIG_TARGET_LOCALE_KOR=y
CONFIG_MACH_JF_SKT=y
CONFIG_EXTRA_FIRMWARE="audience-es325-fw-kor.bin"
CONFIG_EXTRA_FIRMWARE_DIR="firmware"
CONFIG_IRDA_MC96=y
CONFIG_TDMB=y
CONFIG_TDMB_SPI=y
CONFIG_TDMB_VENDOR_FCI=y
CONFIG_TDMB_FC8050=y
CONFIG_TCP_CONG_ADVANCED=y
CONFIG_TCP_CONG_BIC=y
CONFIG_DEFAULT_BIC=y
CONFIG_DEFAULT_TCP_CONG="bic"
CONFIG_TDMB_ANT_DET=y
CONFIG_WLAN_REGION_CODE=201
CONFIG_XFRM=y
CONFIG_XFRM_USER=y
CONFIG_INET_IPCOMP=y
CONFIG_CRYPTO_HMAC=y
CONFIG_CRYPTO_XCBC=y
CONFIG_CRYPTO_NULL=y
CONFIG_CRYPTO_MD5=y
CONFIG_CRYPTO_DES=y
CONFIG_CRYPTO_DEFLATE=y
CONFIG_CAMERA_SW_I2C=y
CONFIG_CAMERA_USE_GSBI7=y
```

## arch/arm/configs/jf_spr_defconfig
```kconfig
CONFIG_MACH_JF_SPR=y
CONFIG_EXTRA_FIRMWARE="audience-es325-fw.bin"
CONFIG_EXTRA_FIRMWARE_DIR="firmware"

# InsideSecure VPN Client
CONFIG_INSIDESECURE_VPNCLIENT=y
```

## arch/arm/configs/jf_tmo_defconfig
```kconfig
CONFIG_MACH_JF_TMO=y
CONFIG_EXTRA_FIRMWARE="audience-es325-fw-tmo.bin"
CONFIG_EXTRA_FIRMWARE_DIR="firmware"
CONFIG_GED_BUILD=y
```

## arch/arm/configs/jf_vzw_defconfig
```kconfig
CONFIG_MACH_JF_VZW=y
CONFIG_EXTRA_FIRMWARE="audience-es325-fw-vzw.bin"
CONFIG_EXTRA_FIRMWARE_DIR="firmware"
# InsideSecure VPN Client
CONFIG_INSIDESECURE_VPNCLIENT=y
#VMWARE RELATED
CONFIG_VMWARE_MVP=y
```

## arch/arm/configs/jf_wifi_defconfig
```kconfig
CONFIG_MACH_JF_EUR=y
CONFIG_EXTRA_FIRMWARE="audience-es325-fw-eur.bin"
CONFIG_EXTRA_FIRMWARE_DIR="firmware"
CONFIG_WIFI_NOMODEM=y

# CONFIG_USB_EHCI_MSM_HSIC is not set
CONFIG_WIFIDEMO_NOMHL=y
```

## arch/arm/configs/jfeng_defconfig
```kconfig
CONFIG_LOCALVERSION=""
CONFIG_MSM_RTB_SEPARATE_CPUS=y
CONFIG_MSM_L2_ERP_PRINT_ACCESS_ERRORS=y
# CONFIG_MSM_L2_ERP_1BIT_PANIC is not set
CONFIG_MSM_CACHE_DUMP=y
CONFIG_MSM_CACHE_DUMP_ON_PANIC=y
CONFIG_USB_MON=y
CONFIG_LOCKUP_DETECTOR=y
CONFIG_DEBUG_KMEMLEAK=y
CONFIG_DEBUG_KMEMLEAK_DEFAULT_OFF=y
CONFIG_DEBUG_SPINLOCK=y
CONFIG_DEBUG_MUTEXES=y
CONFIG_DEBUG_ATOMIC_SLEEP=y
CONFIG_DEBUG_STACK_USAGE=y
CONFIG_BLOCK=y
CONFIG_BLK_DEV_IO_TRACE=y
CONFIG_FAULT_INJECTION=y
CONFIG_FAILSLAB=y
CONFIG_FAIL_PAGE_ALLOC=y
CONFIG_FAULT_INJECTION_DEBUG_FS=y
CONFIG_FAULT_INJECTION_STACKTRACE_FILTER=y
CONFIG_DEBUG_PAGEALLOC=y
CONFIG_SAMSUNG_BATTERY_ENG_TEST=y

# Overriding the rooting prevention feature as disable on ENG build 
# CONFIG_SEC_RESTRICT_ROOTING is not set 
# CONFIG_SEC_RESTRICT_SETUID is not set 
# CONFIG_SEC_RESTRICT_FORK is not set 
# CONFIG_SEC_RESTRICT_ROOTING_LOG is not set 

# Fork hang detection
CONFIG_SEC_FORKHANG_DEBUG=y
```

## arch/arm/configs/jfeng_factory_defconfig
```kconfig
#
# FEATURE CONFIG FOR FACTORY
#
CONFIG_SEC_FACTORY=y

CONFIG_LOCALVERSION=""
CONFIG_MSM_RTB=y
CONFIG_MSM_RTB_SEPARATE_CPUS=y
CONFIG_MSM_L2_ERP_PRINT_ACCESS_ERRORS=y
# CONFIG_MSM_L2_ERP_1BIT_PANIC is not set
CONFIG_MSM_CACHE_DUMP=y
CONFIG_MSM_CACHE_DUMP_ON_PANIC=y
CONFIG_USB_MON=y
CONFIG_LOCKUP_DETECTOR=y
CONFIG_DEBUG_KMEMLEAK=y
CONFIG_DEBUG_KMEMLEAK_DEFAULT_OFF=y
CONFIG_DEBUG_SPINLOCK=y
CONFIG_DEBUG_MUTEXES=y
CONFIG_DEBUG_ATOMIC_SLEEP=y
CONFIG_DEBUG_STACK_USAGE=y
CONFIG_DEBUG_LIST=y
CONFIG_BLOCK=y
CONFIG_BLK_DEV_IO_TRACE=y
CONFIG_FAULT_INJECTION=y
CONFIG_FAILSLAB=y
CONFIG_FAIL_PAGE_ALLOC=y
CONFIG_FAULT_INJECTION_DEBUG_FS=y
CONFIG_FAULT_INJECTION_STACKTRACE_FILTER=y
CONFIG_DEBUG_PAGEALLOC=y
CONFIG_TOUCHSCREEN_FACTORY_PLATFORM=y
CONFIG_SAMSUNG_BATTERY_FACTORY=y

# Overriding the rooting prevention feature as disable on ENG build 
# CONFIG_SEC_RESTRICT_ROOTING is not set 
# CONFIG_SEC_RESTRICT_SETUID is not set 
# CONFIG_SEC_RESTRICT_FORK is not set 
# CONFIG_SEC_RESTRICT_ROOTING_LOG is not set 
```

## arch/arm/configs/jfuserdebug_defconfig
```kconfig
# Overriding the rooting prevention feature as disable on ENG build
# CONFIG_SEC_RESTRICT_ROOTING is not set
# CONFIG_SEC_RESTRICT_SETUID is not set
# CONFIG_SEC_RESTRICT_FORK is not set
# CONFIG_SEC_RESTRICT_ROOTING_LOG is not set
```

## arch/arm/configs/jfve_eur_defconfig
```kconfig
CONFIG_MACH_JFVE_EUR=y
CONFIG_MACH_JFVE_EUR_LTE=y
CONFIG_EXTRA_FIRMWARE="audience-es325-fw-eur.bin"
CONFIG_EXTRA_FIRMWARE_DIR="firmware"

CONFIG_WCNSS_CORE=y
CONFIG_MSM_PIL_RIVA=y
# CONFIG_BCM4335 is not set
# CONFIG_BROADCOM_WIFI_RESERVED_MEM is not set
# CONFIG_WLAN_REGION_CODE is not set
# CONFIG_BCMDHD_FW_PATH is not set
# CONFIG_BCMDHD_NVRAM_PATH is not set
# CONFIG_MMC_MSM_SDC4_SUPPORT is not set
# CONFIG_MMC_MSM_SDC2_SUPPORT is not set

# Bluetooth feature(Qualcomm)
# CONFIG_BT_BCM4335 is not set

CONFIG_DIAGFWD_REMOTE_PROC_TEMP=y
```

## arch/arm/configs/selinux_defconfig
```kconfig
CONFIG_AUDIT=y
CONFIG_AUDITSYSCALL=y
CONFIG_SECURITY=y
CONFIG_LSM_MMAP_MIN_ADDR=4096
CONFIG_SECURITY_NETWORK=y
CONFIG_SECURITY_SELINUX=y
CONFIG_SECURITY_SELINUX_DEVELOP=y
CONFIG_SECURITY_SELINUX_AVC_STATS=y
CONFIG_SECURITY_SELINUX_CHECKREQPROT_VALUE=y
CONFIG_NETWORK_SECMARK=y
CONFIG_NF_CONNTRACT_SECMARK=y
CONFIG_NETFILTER_XT_TARGET_CONNSECMARK=y
CONFIG_NETFILTER_ADVANCED=y
CONFIG_IP_NF_SECURITY=y
CONFIG_DEFAULT_SECURITY=y
CONFIG_DEFAULT_SECURITY="selinux"
```

## drivers/battery/Kconfig
```kconfig
config BATTERY_SAMSUNG
	tristate "samsung battery driver"
	help
	 Say Y to include support for samsung battery driver
	 This battery driver integrated all battery-related functions
	 To see battery-related functions,
	 refer to sec_charging_common.h


# Fuel Gauge

config FUELGAUGE_DUMMY
	tristate "dummy fuel gauge driver"
	default n
	depends on BATTERY_SAMSUNG
	help
	 Say Y to include support
	 for dummy fuel gauge driver.
	 This driver source code implemented
	 skeleton source code for fuel gauge functions.

config FUELGAUGE_MAX17042
	tristate "MAX17042 fuel gauge driver"
	default n
	depends on BATTERY_SAMSUNG
	help
	 Say Y to include support
	 for MAXIM MAX17042 fuel gauge driver.
	 This fuel-gauge can be used in voltage-tracking mode
	 or coulomb-counting mode.

if MACH_MELIUS
config BATTERY_SAMSUNG
	tristate "samsung battery driver"
	help
	 Say Y to include support for samsung battery driver
	 This battery driver integrated all battery-related functions
	 To see battery-related functions,
	 refer to sec_charging_common.h


# Fuel Gauge

config FUELGAUGE_DUMMY
	tristate "dummy fuel gauge driver"
	default n
	depends on BATTERY_SAMSUNG
	help
	 Say Y to include support
	 for dummy fuel gauge driver.
	 This driver source code implemented
	 skeleton source code for fuel gauge functions.
endif

config FUELGAUGE_MAX17042_VOLTAGE_TRACKING
	tristate "use MAX17042 fuel gauge only as voltage tracking"
	default n
	depends on FUELGAUGE_MAX17042
	help
	 Say Y to use MAX17042 fuel gauge
	 only as voltage tracking.
	 This mode is for target that consumes low current
	 like smart-phone.

config FUELGAUGE_MAX17042_COULOMB_COUNTING
	tristate "use MAX17042 fuel gauge as coulomb counting (including voltage tracking)"
	default n
	depends on FUELGAUGE_MAX17042
	help
	 Say Y to use MAX17042 fuel gauge
	 as coulomb counting (including voltage tracking).
	 This mode is for target that consumes high current
	 like tablet.

config FUELGAUGE_MAX17048
	tristate "MAX17048 fuel gauge driver"
	default n
	depends on BATTERY_SAMSUNG
	help
	 Say Y to include support
	 for MAXIM MAX17048 fuel gauge driver.
	 This fuel-gauge can be used
	 only in voltage-tracking mode.

config FUELGAUGE_MAX17050
	tristate "MAX17050 fuel gauge driver"
	default n
	depends on BATTERY_SAMSUNG
	help
	 Say Y to include support
	 for MAXIM MAX17047 or MAX17050 fuel gauge driver.
	 This fuel-gauge can be used in voltage-tracking mode
	 or coulomb-counting mode.

config FUELGAUGE_MAX17050_VOLTAGE_TRACKING
	tristate "use MAX17050 fuel gauge only as voltage tracking"
	default n
	depends on FUELGAUGE_MAX17050
	help
	 Say Y to use MAX17050 fuel gauge
	 only as voltage tracking.
	 This mode is for target that consumes low current
	 like smart-phone.

config FUELGAUGE_MAX17050_COULOMB_COUNTING
	tristate "use MAX17050 fuel gauge as coulomb counting (including voltage tracking)"
	default n
	depends on FUELGAUGE_MAX17050
	help
	 Say Y to use MAX17050 fuel gauge
	 as coulomb counting (including voltage tracking).
	 This mode is for target that consumes high current
	 like tablet.


# Charger

config CHARGER_DUMMY
	tristate "dummy charger driver"
	default n
	depends on BATTERY_SAMSUNG
	help
	 Say Y to include support
	 for dummy charger driver.
	 This driver source code implemented
	 skeleton source code for charger functions.

config CHARGER_MAX8903
	tristate "MAX8903 charger driver"
	default n
	depends on BATTERY_SAMSUNG
	help
	 Say Y to include support
	 for MAXIM MAX8903 charger driver.
	 This driver source code implemented
	 all functions for MAX8903 charger.

config CHARGER_SMB328
	tristate "SMB328 charger driver"
	default n
	depends on BATTERY_SAMSUNG
	help
	 Say Y to include support
	 for Summit SMB328 charger driver.
	 This driver source code implemented
	 all functions for SMB328 charger.

config CHARGER_SMB347
	tristate "SMB347 charger driver"
	default n
	depends on BATTERY_SAMSUNG
	help
	 Say Y to include support
	 for Summit SMB347 charger driver.
	 This driver source code implemented
	 all functions for SMB347 charger.

config CHARGER_BQ24157
	tristate "BQ24157 charger driver"
	default n
	depends on BATTERY_SAMSUNG
	help
	 Say Y to include support
	 for TI BQ24157 charger driver.
	 This driver source code implemented
	 all functions for BQ24157 charger.

config CHARGER_BQ24190
	tristate "BQ24190 charger driver"
	default n
	depends on BATTERY_SAMSUNG
	help
	 Say Y to include support
	 for TI BQ24190 charger driver.
	 This driver source code implemented
	 all functions for BQ24190 charger.

config CHARGER_BQ24191
	tristate "BQ24191 charger driver"
	default n
	depends on BATTERY_SAMSUNG
	help
	 Say Y to include support
	 for TI BQ24191 charger driver.
	 This driver source code implemented
	 all functions for BQ24191 charger.

config CHARGER_MAX77693
	tristate "MAX77693 battery charger support"
	depends on MFD_MAX77693 && I2C
	help
	  Say Y here to enable support for the MAX77693 charger
	  MAX77693 incluse muic, pmic, haptic, led,
	  flash driver.
	  You have to define MFD_MAX77693

config CHARGER_MAX77803
	tristate "MAX77803 battery charger support"
	depends on MFD_MAX77693 && I2C
	help
	  Say Y here to enable support for the MAX77803 charger
	  MAX77803 incluse muic, pmic, haptic, led,
	  flash driver.
	  You have to define MFD_MAX77693

config SAMSUNG_LPM_MODE
	bool "Off charging mode support in sec battery driver"
	default n
	help
	  Say Y to include support for sec off charging support
	  This value defined at bootloader.
	  Before enable this feature,
	  implemet power off charging in the bootloader.

config SAMSUNG_BATTERY_ENG_TEST
	bool "enable ENG mode for battery test"
	default n
	help
	  Say Y to include support for battery test
	  enable this feature only ENG mode
	  this featuren must disabled user binary
	  stability test etc..

config SAMSUNG_BATTERY_FACTORY
	bool "enable for factory test"
	default n
	help
	  Say Y to include support for factory test
	  enable this feature only factory mode
	  this featuren must disabled user binary
	  stability test etc..

if MACH_MELIUS
config CHARGER_MAX77XXX
	tristate "MAX77693 or MAX77803 battery charger support"
	depends on MFD_MAX77693 && I2C
	help
	  Say Y here to enable support for the MAX77803 charger
	  MAX77803 incluse muic, pmic, haptic, led,
	  flash driver.
	  You have to define MFD_MAX77693
endif
```
